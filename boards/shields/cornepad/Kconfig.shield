## boards/shields/cornepad/Kconfig.shield
```kconfig
config SHIELD_CORNEPAD_LEFT
    def_bool $(shields_list_contains,cornepad_left)

config SHIELD_CORNEPAD_RIGHT
    def_bool $(shields_list_contains,cornepad_right)

config SHIELD_CORNEPAD_DONGLE
    def_bool $(shields_list_contains,cornepad_dongle)
```
