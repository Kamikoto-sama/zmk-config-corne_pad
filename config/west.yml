## config/west.yml
```yaml
manifest:
  remotes:
  - name: zmkfirmware
    url-base: https://github.com/zmkfirmware
  - name: halfdane
    url-base: https://github.com/halfdane/
  - name: amgskobo
    url-base: https://github.com/amgskobo
  projects:
  - name: zmk
    remote: zmkfirmware
    revision: v0.3-branch
    import: app/west.yml
  - name: zmk-input-processors
    remote: halfdane
    revision: main
  - name: zmk-input-inertia
    remote: amgskobo
    revision: 8d973612474c6c65d6f83917a9d677f12e1ea827
  - name: cirque-input-module
    remote: halfdane
    revision: absolute_mode
  self:
    path: config
```
